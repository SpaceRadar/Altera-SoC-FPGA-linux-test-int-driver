#include <dt-bindings/interrupt-controller/irq.h>
#include <dt-bindings/interrupt-controller/arm-gic.h>
#include "socfpga_cyclone5my.dts"

/*Extends the SoC with a soft component. */
/ {
	soc{
		mysoftip{
			compatible="altr ,socfpga-mysoftip";
			interrupts=<GIC_SPI 40 IRQ_TYPE_EDGE_RISING>;
            reg = <0xC0000000 0x10000>;
		};
	};
};
